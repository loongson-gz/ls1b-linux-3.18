## arch/mips/loongson1/Kconfig
```kconfig
if MACH_LOONGSON1

choice
	prompt "Machine Type"

config LOONGSON1_LS1A
	bool "Loongson LS1A board"
	select CEVT_R4K if !MIPS_EXTERNAL_TIMER
	select CSRC_R4K if !MIPS_EXTERNAL_TIMER
	select SYS_HAS_CPU_LOONGSON1A
	select DMA_NONCOHERENT
	select BOOT_ELF32
	select IRQ_CPU
	select SYS_SUPPORTS_32BIT_KERNEL
	select SYS_SUPPORTS_LITTLE_ENDIAN
	select SYS_SUPPORTS_HIGHMEM
	select SYS_SUPPORTS_MIPS16
	select SYS_HAS_EARLY_PRINTK
	select COMMON_CLK

config LOONGSON1_LS1B
	bool "Loongson LS1B board"
	select CEVT_R4K if !MIPS_EXTERNAL_TIMER
	select CSRC_R4K if !MIPS_EXTERNAL_TIMER
	select SYS_HAS_CPU_LOONGSON1B
	select DMA_NONCOHERENT
	select BOOT_ELF32
	select IRQ_CPU
	select SYS_SUPPORTS_32BIT_KERNEL
	select SYS_SUPPORTS_LITTLE_ENDIAN
	select SYS_SUPPORTS_HIGHMEM
	select SYS_SUPPORTS_MIPS16
	select SYS_HAS_EARLY_PRINTK
	select COMMON_CLK

config LOONGSON1_LS1C
	bool "Loongson LS1C board"
	select CEVT_R4K if !MIPS_EXTERNAL_TIMER
	select CSRC_R4K if !MIPS_EXTERNAL_TIMER
	select SYS_HAS_CPU_LOONGSON1C
	select DMA_NONCOHERENT
	select BOOT_ELF32
	select IRQ_CPU
	select SYS_SUPPORTS_32BIT_KERNEL
	select SYS_SUPPORTS_LITTLE_ENDIAN
	select SYS_SUPPORTS_HIGHMEM
	select SYS_SUPPORTS_MIPS16
	select SYS_HAS_EARLY_PRINTK
	select COMMON_CLK

endchoice

endif # MACH_LOONGSON1
```

## drivers/iio/potentiometer/Kconfig
```kconfig
#
# Potentiometer drivers
#
# When adding new entries keep the list in alphabetical order

menu "Digital potentiometers"

config MAX5432
	tristate "Maxim MAX5432/MAX5433/MAX5434/MAX5435 Digital Potentiometer driver"
	depends on I2C
	help
	  Say yes here to build support for the Maxim
	  MAX5432, MAX5433, MAX5434, MAX5435 digital
	  potentiometer chips.

	  To compile this driver as a module, choose M here: the
	  module will be called max5432.

endmenu
```
